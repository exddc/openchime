## buildroot/Config.in
```kconfig
# Chime external packages
source "$BR2_EXTERNAL_OPENCHIME_PATH/package/chime-web-ui/Config.in"
source "$BR2_EXTERNAL_OPENCHIME_PATH/package/chime/Config.in"
```

## buildroot/package/chime-web-ui/Config.in
```kconfig
config BR2_PACKAGE_CHIME_WEB_UI
	bool "chime-web-ui"
	help
	  Production Svelte UI for chime-webd, installed to
	  /usr/local/share/chime-web-ui/dist. Selected by the chime
	  package; first-boot images cannot omit it.
```
